## components/ethernet_helper/Kconfig.projbuild
```kconfig
menu "Ethernet Helper Configuration"
    choice ETHERNET_HELPER_INTERFACE
        prompt "Connect using"
        default ETHERNET_HELPER_WIFI
        help
            Protocol examples can use Wi-Fi or Ethernet to connect to the network.
            Choose which interface to use.

        config ETHERNET_HELPER_WIFI
            bool "Wi-Fi"

        config ETHERNET_HELPER_ETHERNET
            bool "Ethernet"

    endchoice

    if ETHERNET_HELPER_WIFI
        config ETHERNET_HELPER_WIFI_SSID
            string "WiFi SSID"
            default "myssid"
            help
                SSID (network name) to connect to.

        config ETHERNET_HELPER_WIFI_PASSWORD
            string "WiFi Password"
            default "mypassword"
            help
                WiFi password (WPA or WPA2) to use.
                Can be left blank if the network has no security set.
    endif

    if ETHERNET_HELPER_ETHERNET
        choice ETHERNET_HELPER_USE_ETHERNET
            prompt "Ethernet Type"
            default ETHERNET_HELPER_USE_INTERNAL_ETHERNET if IDF_TARGET_ESP32
            default ETHERNET_HELPER_USE_DM9051 if !IDF_TARGET_ESP32
            help
                Select which kind of Ethernet will be used.

            config ETHERNET_HELPER_USE_INTERNAL_ETHERNET
                depends on IDF_TARGET_ESP32
                select ETH_USE_ESP32_EMAC
                bool "Internal EMAC"
                help
                    Select internal Ethernet MAC controller.

            config ETHERNET_HELPER_USE_DM9051
                bool "DM9051 Module"
                select ETH_USE_SPI_ETHERNET
                select ETH_SPI_ETHERNET_DM9051
                help
                    Select external SPI-Ethernet module.

            config ETHERNET_HELPER_USE_OPENETH
                bool "OpenCores Ethernet MAC (EXPERIMENTAL)"
                select ETH_USE_OPENETH
                help
                    When this option is enabled, the app is built with support for
                    OpenCores Ethernet MAC, which allows testing the app in QEMU.
                    Note that this option is used for internal testing purposes, and
                    not officially supported. Examples built with this option enabled
                    will not run on a real ESP32 chip.

        endchoice

        if ETHERNET_HELPER_USE_INTERNAL_ETHERNET
            choice ETHERNET_HELPER_ETH_PHY_MODEL
                prompt "Ethernet PHY Device"
                default ETHERNET_HELPER_ETH_PHY_IP101
                help
                    Select the Ethernet PHY device to use.

                config ETHERNET_HELPER_ETH_PHY_IP101
                    bool "IP101"
                    help
                        IP101 is a single port 10/100 MII/RMII/TP/Fiber Fast Ethernet Transceiver.
                        Goto http://www.icplus.com.tw/pp-IP101G.html for more information about it.

                config ETHERNET_HELPER_ETH_PHY_RTL8201
                    bool "RTL8201/SR8201"
                    help
                        RTL8201F/SR8201F is a single port 10/100Mb Ethernet Transceiver with auto MDIX.
                        Goto http://www.corechip-sz.com/productsview.asp?id=22 for more information about it.

                config ETHERNET_HELPER_ETH_PHY_LAN8720
                    bool "LAN8720"
                    help
                        LAN8720A is a small footprint RMII 10/100 Ethernet Transceiver with HP Auto-MDIX Support.
                        Goto https://www.microchip.com/LAN8720A for more information about it.

                config ETHERNET_HELPER_ETH_PHY_DP83848
                    bool "DP83848"
                    help
                        DP83848 is a single port 10/100Mb/s Ethernet Physical Layer Transceiver.
                        Goto http://www.ti.com/product/DP83848J for more information about it.
            endchoice

            config ETHERNET_HELPER_ETH_MDC_GPIO
                int "SMI MDC GPIO number"
                default 23
                help
                    Set the GPIO number used by SMI MDC.

            config ETHERNET_HELPER_ETH_MDIO_GPIO
                int "SMI MDIO GPIO number"
                default 18
                help
                    Set the GPIO number used by SMI MDIO.
        endif

        if ETHERNET_HELPER_USE_DM9051
            config ETHERNET_HELPER_DM9051_SPI_HOST
                int "SPI Host Number"
                range 0 2
                default 1
                help
                    Set the SPI host used to communicate with DM9051.

            config ETHERNET_HELPER_DM9051_SCLK_GPIO
                int "SPI SCLK GPIO number"
                range 0 33
                default 19
                help
                    Set the GPIO number used by SPI SCLK.

            config ETHERNET_HELPER_DM9051_MOSI_GPIO
                int "SPI MOSI GPIO number"
                range 0 33
                default 23
                help
                    Set the GPIO number used by SPI MOSI.

            config ETHERNET_HELPER_DM9051_MISO_GPIO
                int "SPI MISO GPIO number"
                range 0 33
                default 25
                help
                    Set the GPIO number used by SPI MISO.

            config ETHERNET_HELPER_DM9051_CS_GPIO
                int "SPI CS GPIO number"
                range 0 33
                default 22
                help
                    Set the GPIO number used by SPI CS.

            config ETHERNET_HELPER_DM9051_SPI_CLOCK_MHZ
                int "SPI clock speed (MHz)"
                range 20 80
                default 20
                help
                    Set the clock speed (MHz) of SPI interface.

            config ETHERNET_HELPER_DM9051_INT_GPIO
                int "Interrupt GPIO number"
                default 4
                help
                    Set the GPIO number used by DM9051 interrupt.
        endif

        config ETHERNET_HELPER_ETH_PHY_RST_GPIO
            int "PHY Reset GPIO number"
            default 5
            help
                Set the GPIO number used to reset PHY chip.
                Set to -1 to disable PHY chip hardware reset.

        config ETHERNET_HELPER_ETH_PHY_ADDR
            int "PHY Address"
            range 0 31 if ETHERNET_HELPER_USE_INTERNAL_ETHERNET
            range 1 1 if !ETHERNET_HELPER_USE_INTERNAL_ETHERNET
            default 1
            help
                Set PHY address according your board schematic.
    endif


    if ETHERNET_HELPER_WIFI
		config ETHERNET_HELPER_STATIC_IP4
			bool "Static IPv4"
			default n
			help
				If this option is enabled, you can define a static IP address. Otherwise DHCP will be used
	endif


	if ETHERNET_HELPER_STATIC_IP4

		config ETHERNET_HELPER_STATIC_IP4_ADDRESS
			string "Static IPv4 Address"
			default "192.168.1.42"
			help
				Static IP Address

		config ETHERNET_HELPER_STATIC_IP4_GATEWAY
			string "Static IPv4 Gateway"
			default "192.168.1.1"
			help
				Static IP Address Gateway

		config ETHERNET_HELPER_STATIC_IP4_NETMASK
			string "Static IPv4 Netmask"
			default "255.255.255.0"
			help
				Static IP Address Netmask

		config ETHERNET_HELPER_STATIC_DNS_MAIN
			string "Main DNS Address"
			default "8.8.8.8"
			help
				Main DNS Server IP Address

		config ETHERNET_HELPER_STATIC_DNS_FALLBACK
			string "Fallback DNS Address (empty for disable)"
			default ""
			help
				Fallback DNS Server IP Address
	endif

	config ETHERNET_HELPER_CUSTOM_HOSTNAME
		bool "Use custom hostname"
		default n
		help
			If this option is enabled, you can define a custom hostname

	if ETHERNET_HELPER_CUSTOM_HOSTNAME
		config ETHERNET_HELPER_CUSTOM_HOSTNAME_STR
			string "Hostname"
			default "esp32-host"
			help
				Custom Hostname
	endif

    config ETHERNET_HELPER_IPV6
        bool "Obtain IPv6 link-local address"
        depends on IDF_TARGET_ESP32
        # ToDo: remove once IPV6 is supported on esp32s2
        default y
        help
            By default, the app will wait until IPv4 and IPv6 addresses are obtained.
            Disable this option if the network does not support IPv6.
endmenu
```

## sdkconfig.defaults
```kconfig
CONFIG_PARTITION_TABLE_CUSTOM=y
CONFIG_PARTITION_TABLE_CUSTOM_FILENAME="partitions_example.csv"
CONFIG_PARTITION_TABLE_FILENAME="partitions_example.csv"
CONFIG_PARTITION_TABLE_OFFSET=0x9000
CONFIG_COMPILER_CXX_EXCEPTIONS=y
```
